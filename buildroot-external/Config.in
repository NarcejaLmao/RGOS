## buildroot-external/Config.in
```kconfig
source "$BR2_EXTERNAL_RGOS_PATH/package/rgos-retroarch/Config.in"
source "$BR2_EXTERNAL_RGOS_PATH/package/rgos-libretro-mgba/Config.in"
```

## buildroot-external/configs/rgos_rg34xxsp_defconfig
```kconfig
BR2_CCACHE=y
BR2_CCACHE_DIR="$(HOME)/.buildroot-ccache"
BR2_aarch64=y
BR2_cortex_a53=y
BR2_TOOLCHAIN_BUILDROOT_GLIBC=y
BR2_TOOLCHAIN_BUILDROOT_CXX=y
BR2_TARGET_GENERIC_HOSTNAME="rgos"
BR2_TARGET_GENERIC_ISSUE=""
BR2_INIT_BUSYBOX=y
BR2_ROOTFS_DEVICE_CREATION_STATIC=y
BR2_SYSTEM_BIN_SH_BUSYBOX=y
BR2_ROOTFS_OVERLAY="$(BR2_EXTERNAL_RGOS_PATH)/board/rgos/overlay $(BR2_EXTERNAL_RGOS_PATH)/board/rgos/pygame-overlay"
BR2_PACKAGE_PYTHON3=y
BR2_PACKAGE_PYTHON3_ZLIB=y
BR2_PACKAGE_LIBFFI=y
BR2_PACKAGE_ALSA_LIB=y
BR2_PACKAGE_DEJAVU=y
BR2_PACKAGE_KMOD=y
BR2_PACKAGE_KMOD_TOOLS=y
BR2_PACKAGE_XZ=y
BR2_PACKAGE_ZSTD=y
BR2_PACKAGE_ALSA_UTILS=y
BR2_PACKAGE_ALSA_UTILS_AMIXER=y
BR2_TARGET_ROOTFS_CPIO=y
BR2_TARGET_ROOTFS_CPIO_GZIP=y
BR2_PACKAGE_EXFATPROGS=y
BR2_PACKAGE_UTIL_LINUX=y
BR2_PACKAGE_UTIL_LINUX_BINARIES=y
BR2_PACKAGE_UTIL_LINUX_LIBBLKID=y
BR2_PACKAGE_UTIL_LINUX_LIBFDISK=y
BR2_PACKAGE_UTIL_LINUX_LIBMOUNT=y
BR2_PACKAGE_UTIL_LINUX_LIBSMARTCOLS=y
BR2_PACKAGE_UTIL_LINUX_LIBUUID=y
BR2_PACKAGE_UTIL_LINUX_FDISK=y
BR2_PACKAGE_UTIL_LINUX_SFDISK=y
BR2_PACKAGE_UTIL_LINUX_PARTX=y
BR2_PACKAGE_COREUTILS=y
BR2_PACKAGE_ZLIB=y
BR2_PACKAGE_LIBDRM=y
BR2_PACKAGE_MESA3D=y
BR2_PACKAGE_LLVM=y
BR2_PACKAGE_MESA3D_LLVM=y
BR2_PACKAGE_MESA3D_GALLIUM_DRIVER_PANFROST=y
BR2_PACKAGE_MESA3D_GALLIUM_DRIVER_KMSRO=y
BR2_PACKAGE_MESA3D_OPENGL_EGL=y
BR2_PACKAGE_MESA3D_OPENGL_ES=y
BR2_PACKAGE_SDL2=y
BR2_PACKAGE_MESA3D_GBM=y
BR2_PACKAGE_RGOS_RETROARCH=y
BR2_PACKAGE_RGOS_LIBRETRO_MGBA=y
```

## buildroot-external/package/rgos-libretro-mgba/Config.in
```kconfig
config BR2_PACKAGE_RGOS_LIBRETRO_MGBA
	bool "rgos-libretro-mgba (Game Boy Advance core)"
	depends on BR2_PACKAGE_RGOS_RETROARCH
	depends on BR2_TOOLCHAIN_HAS_THREADS
	help
	  mGBA as a libretro core (mgba_libretro.so), cross-built for the
	  target CPU (aarch64 / Cortex-A53 on the RG34XX-SP). Plays GBA,
	  GB and GBC content. Installed to /usr/lib/libretro, which is where
	  the RG OS menu looks for cores.

	  https://github.com/libretro/mgba

if BR2_PACKAGE_RGOS_LIBRETRO_MGBA

config BR2_PACKAGE_RGOS_LIBRETRO_MGBA_VERSION
	string "mGBA libretro git ref"
	default "7a12d6d4b9acb14c0ae62c9166b6a2f3d08007f6"
	help
	  Branch, tag or commit of github.com/libretro/mgba to build.
	  "master" always works but is not reproducible: pin a commit id
	  here once you have a build you trust, and then add its sha256 to
	  package/rgos-libretro-mgba/rgos-libretro-mgba.hash.

endif

comment "rgos-libretro-mgba needs RetroArch and a toolchain with threads"
	depends on !BR2_PACKAGE_RGOS_RETROARCH || !BR2_TOOLCHAIN_HAS_THREADS
```

## buildroot-external/package/rgos-retroarch/Config.in
```kconfig
config BR2_PACKAGE_RGOS_RETROARCH
	bool "rgos-retroarch (RetroArch frontend)"
	depends on BR2_TOOLCHAIN_HAS_THREADS
	depends on BR2_INSTALL_LIBSTDCPP
	depends on !BR2_STATIC_LIBS
	depends on BR2_PACKAGE_MESA3D_GBM
	depends on BR2_PACKAGE_MESA3D_OPENGL_EGL
	depends on BR2_PACKAGE_MESA3D_OPENGL_ES
	select BR2_PACKAGE_LIBDRM
	select BR2_PACKAGE_ALSA_LIB
	select BR2_PACKAGE_SDL2
	select BR2_PACKAGE_ZLIB
	help
	  RetroArch (libretro frontend), cross-built from source for
	  the RG34XX-SP: KMS/DRM + EGL/GLES (Mesa Panfrost), ALSA audio,
	  SDL2 for input, RGUI menu. Buildroot has no RetroArch package of
	  its own, so this one lives in the RG OS external tree.

	  https://github.com/libretro/RetroArch

if BR2_PACKAGE_RGOS_RETROARCH

config BR2_PACKAGE_RGOS_RETROARCH_VERSION
	string "RetroArch git tag"
	default "v1.22.2"
	help
	  Tag, branch or commit of github.com/libretro/RetroArch.

endif

comment "rgos-retroarch needs a glibc/uClibc toolchain with threads + C++, dynamic libs, and Mesa3D with GBM, EGL and GLES"
	depends on !BR2_TOOLCHAIN_HAS_THREADS || !BR2_INSTALL_LIBSTDCPP || BR2_STATIC_LIBS || \
		!BR2_PACKAGE_MESA3D_GBM || !BR2_PACKAGE_MESA3D_OPENGL_EGL || !BR2_PACKAGE_MESA3D_OPENGL_ES
```
